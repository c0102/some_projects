## iskra_sg/main/Kconfig.projbuild
```kconfig
menu "Ethernet Board Configuration"

	choice BOARD_TYPE
            prompt "Board Type"
            default BOARD_SG
            help
                Select board type.
            config BOARD_SG
                bool "BOARD_SG"
                help
                    BOARD_SG is Smart gateway. 
                    
            config BOARD_IE14MW
                bool "BOARD_IE14MW"
                help
                    BOARD_IE14MW is one phase meter with wifi communication.                                  
                    
            config BOARD_OLIMEX_ESP32_GATEWAY
                bool "BOARD_OLIMEX_ESP32_GATEWAY"
                help
                    BOARD_OLIMEX_ESP32_GATEWAY is Olimex Gateway Demo Board.   
                    
            config BOARD_ESP32_DEMO
                bool "BOARD_ESP32_DEMO"
                help
                    BOARD_ESP32_DEMO is low cost demo board                                                                                    
    endchoice
        
    config SERIAL_NUMBER
        string "SERIAL NUMBER"
        default "SG000001"
        help
            default serial number (8 alphanumeric characters)                                  
    
    menu "WiFi Configuration"            
        config WIFI_SSID
            string "WiFi SSID"
            default "Tsenzor"
            help
                SSID (network name) for the example to connect to.
                
        config WIFI_PASSWORD
            string "WiFi Password"
            default "mer2senzor_temp33"
            help
                WiFi password (WPA or WPA2) for the example to use.
                
        config WIFI_MAXIMUM_RETRY
            int "Maximum WiFi connection retry"
            default 10
            help
                Set the Maximum retry to avoid station reconnecting to the AP unlimited when the AP is really inexistent.
                
        choice WIFI_PROVISIONING
            prompt "WiFi provisioning"        	
            bool        	        	
            default BLE_PROV_MANAGER_ENABLED        
            help
                Enable or disable ble_prov.
            
            config BLE_PROV_MANAGER_ENABLED
                bool "BLE_PROV_MANAGER_ENABLED"
                help
                    Unified BLE Manager Provisioning
            	    
            config WIFI_PROVISIONING_NONE
            	bool "NONE"
            	help
            	    Blufi provisioning            	                
                      
        endchoice
        
        config BLE_USE_SEC_1
            bool
            depends on BLE_PROV_ENABLED
            default y
            prompt "Use Security Version 1"
            help
                Security version 1 used Curve25519 key exchange for establishing
                secure session between device and client during provisioning

        config BLE_USE_POP
            bool
            depends on BLE_USE_SEC_1
            default y
            prompt "Use proof-of-possession"
            help
                Proof-of-possession can be optionally used to prove that the device is indeed
                in possession of the user who is provisioning the device. This proof-of-possession
                is internally used to generate the shared secret through key exchange.

        config BLE_POP
            string "Proof-of-possession"
            default "abcd1234"
            depends on BLE_USE_POP         	
            
    endmenu    
    
    menu "Ethernet Configuration"
        depends on BOARD_SG        
        choice PHY_MODEL
            prompt "Ethernet PHY Device"
            default PHY_LAN8720
            help
                Select the PHY driver to use for the example.
            config PHY_IP101
                bool "IP101"
                help
                    IP101 is a single port 10/100 MII/RMII/TP/Fiber Fast Ethernet Transceiver.
                    Goto http://www.icplus.com.tw/pp-IP101G.html for more information about it.
            config PHY_TLK110
                bool "TLK110"
                help
                    TLK110 is an Industrial 10/100Mbps Ethernet Physical Layer Transceiver.
                    Goto http://www.ti.com/product/TLK110 for information about it.
            config PHY_LAN8720
                bool "LAN8720"
                help
                    LAN8720 is a small footprint RMII 10/100 Ethernet Transceiver with HP Auto-MDIX Support.
                    Goto https://www.microchip.com/LAN8720A for more information about it.
        endchoice

        config PHY_ADDRESS
            int "Ethernet PHY Address"
            default 0
            range 0 31
            help
                PHY Address of your PHY device. It dependens on your schematic design.        

        config PHY_USE_POWER_PIN
            bool "Use PHY Power (enable / disable) pin"
            default n
            help
                Use a GPIO "power pin" to power the PHY on/off during operation.
                When using GPIO0 to input RMII clock, the reset process will be interfered by this clock.
                So we need another GPIO to control the switch on / off of the RMII clock.

        if PHY_USE_POWER_PIN
            config PHY_POWER_PIN
                int "PHY Power GPIO"
                default 17
                range 0 33
                depends on PHY_USE_POWER_PIN
                help
                    GPIO number to use for powering on/off the PHY.
        endif        
            
        endmenu          
    
    menu "MQTT Configuration"
                     
        config MQTT_ROOT_TOPIC
            string "MQTT Root Topic"
            default "devices"
            help
                root mqtt topic
            
        config MQTT_PUBLISH_TOPIC
            string "MQTT Publish Topic"
            default "publish"
            help
                publish mqtt topic    
            
        config MQTT_SUBSCRIBE_TOPIC
            string "MQTT Subscribe Topic"
            default "cmd"
            help
                subscribe mqtt topic
                
        endmenu                                                           
                    
    config NTP_SERVER_1
        string "NTP Server URL"
        default "ntp1.arnes.si"
        help
            URL of NTP server for time synchronization
            
    config NTP_SERVER_2
        string "NTP Server URL"
        default "ntp2.arnes.si"
        help
            URL of NTP server for time synchronization                            	
	                              
    config NTP_SERVER_3
        string "NTP Server URL"
        default "ntp3.arnes.si"
        help
            URL of NTP server for time synchronization                                      
endmenu
```
